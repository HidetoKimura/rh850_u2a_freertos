//-------------------------------------------------------------------------
//      ILINK layout template for the Renesas RH850 microcontroller
//
//      Copyright 2012-2020 IAR Systems AB.
// 
//-------------------------------------------------------------------------

if (isdefinedsymbol(__ROPI))
{
  define exported symbol __ROPI_NULL = 0;
  initialize by copy with packing = none 
  {
    rw
  };
  initialize manually
  {
    section .table.interrupt_core_0,
    section .table.interrupt_core_1,
    section .table.interrupt_core_2,
    section .table.interrupt_core_3,
    section .table.interrupt_core_4,
    section .table.interrupt_core_5,
    section .table.interrupt_core_6,
    section .table.interrupt_core_7
  };
}
else
{
  initialize by copy
  {
    rw
  };
}                  

do not initialize
{
  section *.noinit
};

initialize by copy with packing = none { section __DLIB_PERTHREAD };

define block SBSS with static base GP, alignment=8, maximum size = 64K 
{ 
  section __DLIB_PERTHREAD,
  rw section .sbss*,
  rw section .sdata*
};
                               
define block SBSS23 with alignment=8, maximum size = 8M 
{ 
  rw section .sdata23*,
  midway block SBSS,
  rw section .sbss23* 
};

if (isdefinedsymbol(__ROPI))
{
  define movable block TP_BLOCK with static base TP, alignment=8, maximum size = 64K, minimum size = 4
  {
    ro section .sconst,
    ro section .pcconst16
  };
                                   
  define movable block TP23_BLOCK with alignment=8, maximum size = 8M 
  { 
    ro section .sconst23,
    ro section .pcconst23,
    midway block TP_BLOCK 
  };

  define movable block TP32_BLOCK with alignment=8, maximum size = 2G
  { 
    ro section .const,
    block TP23_BLOCK,
    ro section .pcconst32,
    section .table.interrupt_core_0_init,
    section .table.interrupt_core_1_init,
    section .table.interrupt_core_2_init,
    section .table.interrupt_core_3_init,
    section .table.interrupt_core_4_init,
    section .table.interrupt_core_5_init,
    section .table.interrupt_core_6_init,
    section .table.interrupt_core_7_init,
    ro
  };
}
else
{
  define block TP_BLOCK with static base TP, alignment=8, maximum size = 64K
  {
    ro section .sconst,
    ro section .pcconst16
  };
                                   
  define block TP23_BLOCK with alignment=8, maximum size = 8M 
  { 
    ro section .sconst23,
    ro section .pcconst23,
    midway block TP_BLOCK 
  };

  define block ROM_BLOCK with fixed order
  { 
    block TP23_BLOCK,
    ro section .pcconst32
  };
}
define block EP_BLOCK with alignment=8, maximum size=16
{ 
  rw section .tbss4*,
  rw section .tdata4*
};
                
define block EBSS5      with fixed order, maximum size = 32
{ 
  block EP_BLOCK, 
  rw section .tbss5*,
  rw section .tdata5*
};

define block EBSS6      with fixed order, maximum size = 64
{ 
  block EBSS5,
  rw section .tbss6*,
  rw section .tdata6* 
};

define block EBSS7      with fixed order, maximum size = 128
{ 
  block EBSS6, 
  rw section .tbss7*,
  rw section .tdata7* 
};

define block EBSS8 with static base EP, fixed order, maximum size = 256
{ 
  block EBSS7,
  rw section .tbss8*,
  rw section .tdata8*
};

define block CALLT      with fixed order, maximum size = 64K, alignment = 2
{ 
  ro section .table.callt,
  ro section .text.callt
};

define block TRAP       with fixed order, maximum size = 64K, alignment = 2
{ 
  ro section .dispatch.trap,
  ro section .table.trap,
  ro section .text.trap 
};

define block FETRAP     with fixed order, maximum size = 64K, alignment = 2
{ 
  ro section .dispatch.fetrap,
  ro section .table.fetrap,
  ro section .text.fetrap 
};

define block HVTRAP     with fixed order, maximum size = 64K, alignment = 2
{ 
  ro section .dispatch.hvtrap,
  ro section .table.hvtrap,
  ro section .text.hvtrap
};

define block RAM_BLOCK with fixed order
{
  block SBSS23,
  block EBSS8,
};
 
define block HEAP     with alignment = 8, size = HEAP_SIZE 
{
};

define block CSTACK   with alignment = 8, size = CSTACK_SIZE
{ 
  section CSTACK
};

define block CSTACK0   with alignment = 8, size = CSTACK_SIZE
{ 
  section CSTACK0
};

define block CSTACK1   with alignment = 8, size = CSTACK_SIZE
{ 
  section CSTACK1
};

define block CSTACK2   with alignment = 8, size = CSTACK_SIZE
{ 
  section CSTACK2
};

define block CSTACK3   with alignment = 8, size = CSTACK_SIZE
{ 
  section CSTACK3
};

define block CSTACK4   with alignment = 8, size = CSTACK_SIZE
{ 
  section CSTACK4
};

define block CSTACK5   with alignment = 8, size = CSTACK_SIZE
{ 
  section CSTACK5
};

define block CSTACK6   with alignment = 8, size = CSTACK_SIZE
{ 
  section CSTACK6
};

define block CSTACK7   with alignment = 8, size = CSTACK_SIZE
{ 
  section CSTACK7
};

define block .reset with alignment = 16
{ 
  ro section RCODE, 
  ro section .reset,
};

define block .syscalltable with alignment = 4 
                                        {  
  ro section .syscalltable
};

define block .hvcalltable with alignment = 4 
{  
  ro section .hvcalltable
};

"RESET":place at address mem:0x0
{ 
  block .reset 
};

if (isdefinedsymbol(__IAR_RESET2_ADDR))
{
  define block .reset2 with alignment = 16
  { 
    ro section .reset2,
  };
  "RESET2":place at address mem:__IAR_RESET2_ADDR
  { 
    block .reset2 
  };
}

if (isdefinedsymbol(__IAR_RESET3_ADDR))
{
  define block .reset3 with alignment = 16
  { 
    ro section .reset3,
  };
  "RESET3":place at address mem:__IAR_RESET3_ADDR
  { 
    block .reset3 
  };
}

if (isdefinedsymbol(__IAR_RESET4_ADDR))
{
  define block .reset4 with alignment = 16
  { 
    ro section .reset4,
  };
  "RESET4":place at address mem:__IAR_RESET4_ADDR
  { 
    block .reset4 
  };
}

if (isdefinedsymbol(__IAR_RESET5_ADDR))
{
  define block .reset5 with alignment = 16
  { 
    ro section .reset5,
  };
  "RESET5":place at address mem:__IAR_RESET5_ADDR
  { 
    block .reset5 
  };
}

if (isdefinedsymbol(__IAR_RESET6_ADDR))
{
  define block .reset6 with alignment = 16
  { 
    ro section .reset6,
  };
  "RESET6":place at address mem:__IAR_RESET6_ADDR
  { 
    block .reset6 
  };
}

if (isdefinedsymbol(__IAR_RESET7_ADDR))
{
  define block .reset7 with alignment = 16
  { 
    ro section .reset7,
  };
  "RESET7":place at address mem:__IAR_RESET7_ADDR
  { 
    block .reset7 
  };
}

if (isdefinedsymbol(__IAR_RESET8_ADDR))
{
  define block .reset8 with alignment = 16
  { 
    ro section .reset8,
  };
  "RESET8":place at address mem:__IAR_RESET8_ADDR
  { 
    block .reset8 
  };
}

if (isdefinedsymbol(__IAR_RESET9_ADDR))
{
  define block .reset9 with alignment = 16
  { 
    ro section .reset9,
  };
  "RESET9":place at address mem:__IAR_RESET9_ADDR
  { 
    block .reset9 
  };
}

if (isdefinedsymbol(__IAR_RESET10_ADDR))
{
  define block .reset10 with alignment = 16
  { 
    ro section .reset10,
  };
  "RESET10":place at address mem:__IAR_RESET10_ADDR
  { 
    block .reset10 
  };
}

if (isdefinedsymbol(__IAR_RESET11_ADDR))
{
  define block .reset11 with alignment = 16
  { 
    ro section .reset11,
  };
  "RESET11":place at address mem:__IAR_RESET11_ADDR
  { 
    block .reset11 
  };
}

if (isdefinedsymbol(__IAR_RESET12_ADDR))
{
  define block .reset12 with alignment = 16
  { 
    ro section .reset12,
  };
  "RESET12":place at address mem:__IAR_RESET12_ADDR
  { 
    block .reset12 
  };
}

if (isdefinedsymbol(__IAR_RESET13_ADDR))
{
  define block .reset13 with alignment = 16
  { 
    ro section .reset13,
  };
  "RESET13":place at address mem:__IAR_RESET13_ADDR
  { 
    block .reset13 
  };
}

if (isdefinedsymbol(__IAR_RESET14_ADDR))
{
  define block .reset14 with alignment = 16
  { 
    ro section .reset14,
  };
  "RESET14":place at address mem:__IAR_RESET14_ADDR
  { 
    block .reset14 
  };
}

if (isdefinedsymbol(__IAR_RESET15_ADDR))
{
  define block .reset15 with alignment = 16
  { 
    ro section .reset15,
  };
  "RESET15":place at address mem:__IAR_RESET15_ADDR
  { 
    block .reset15 
  };
}

if (isdefinedsymbol(__IAR_RESET16_ADDR))
{
  define block .reset16 with alignment = 16
  { 
    ro section .reset16,
  };
  "RESET16":place at address mem:__IAR_RESET16_ADDR
  { 
    block .reset16 
  };
}

"ROMNEAR":place in ROM_near
{
  ro section .zconst
};
                                           
"RAMNEAR":place in RAM_near
{
  rw section .zbss,
  rw section .zdata,
  rw section .ndata,
};


if (isdefinedsymbol(__ROPI))
{
  "ROM1ST":place in ROM_1ST_region
  { 
    block CALLT,
    block TRAP,
    block FETRAP,
    block HVTRAP,
    block .syscalltable,
    block .hvcalltable,
    block TP32_BLOCK
  };
}
else
{                                           
  "ROM1ST":place in ROM_1ST_region
  { 
    block CALLT,
    block TRAP,
    block FETRAP,
    block HVTRAP,
    ro,
    ro section .const,
    block .syscalltable,
    block .hvcalltable,
    block ROM_BLOCK
  };
}                               
"ROM2ND":place in ROM_2ND_region
{ 
  ro section SECOND_ROM*
};
                               
"ROM3RD":place in ROM_3RD_region
{ 
  ro section THIRD_ROM*
};
                               
"ROM4TH":place in ROM_4TH_region
{ 
  ro section FOURTH_ROM*
};
                               
"ROM5TH":place in ROM_5TH_region
{ 
  ro section FIFTH_ROM*
};
                               
"ROM6TH":place in ROM_6TH_region
{ 
  ro section SIXTH_ROM*
};
                               
"ROM7TH":place in ROM_7TH_region
{ 
  ro section SEVENTH_ROM*
};
                               
"ROM8TH":place in ROM_8TH_region
{ 
  ro section EIGHTH_ROM*
};
                               
"ROM9TH":place in ROM_9TH_region
{ 
  ro section NINTH_ROM*
};
                               
"ROM10TH":place in ROM_10TH_region
{ 
  ro section TENTH_ROM*
};
                               
"ROM11TH":place in ROM_11TH_region
{ 
  ro section ELEVENTH_ROM*
};
                               
"ROM12TH":place in ROM_12TH_region
{ 
  ro section TWELFTH_ROM*
};
                               
"ROM13TH":place in ROM_13TH_region
{ 
  ro section THIRTEENTH_ROM*
};
                               
"ROM14TH":place in ROM_14TH_region
{ 
  ro section FOURTEENTH_ROM*
};
                               
"ROM15TH":place in ROM_15TH_region
{ 
  ro section FIFTEENTH_ROM*
};
                               
"ROM16TH":place in ROM_16TH_region
{ 
  ro section SIXTEENTH_ROM*
};
                               
"RAM1ST":place in RAM_1ST_region
{ 
  rw,
  rw section .bss,
  rw section .data,
  block RAM_BLOCK,
  block HEAP,
  block CSTACK 
};
                               
"RAM2ND":place in RAM_2ND_region
{ 
  rw section SECOND_RAM*
};

"RAM3RD":place in RAM_3RD_region
{ 
  rw section THIRD_RAM*
};

"RAM4TH":place in RAM_4TH_region
{ 
  rw section FOURTH_RAM*
};

"RAM5TH":place in RAM_5TH_region
{ 
  rw section FIFTH_RAM*
};

"RAM6TH":place in RAM_6TH_region
{ 
  rw section SIXTH_RAM*
};

"RAM7TH":place in RAM_7TH_region
{ 
  rw section SEVENTH_RAM*
};

"RAM8TH":place in RAM_8TH_region
{ 
  rw section EIGHTH_RAM*
};

"RAM9TH":place in RAM_9TH_region
{ 
  rw section NINTH_RAM*
};

"RAM10TH":place in RAM_10TH_region
{ 
  rw section TENTH_RAM*
};

"RAM11TH":place in RAM_11TH_region
{ 
  rw section ELEVENTH_RAM*
};

"RAM12TH":place in RAM_12TH_region
{ 
  rw section TWELFTH_RAM*
};

if (isdefinedsymbol(__ROPI) && size(SELF_AREA_region) != 0 )
{
  define overlay SELF_AREA_OVERLAY 
  { 
    block CSTACK0,
    rw section SELF_AREA0*,
    section .table.interrupt_core_0
  };
}
else
{
  define overlay SELF_AREA_OVERLAY 
  { 
    block CSTACK0,
    rw section SELF_AREA0*
  };
}

if (isdefinedsymbol(__ROPI) && size(SELF_AREA_region) != 0 )
{
  define overlay SELF_AREA_OVERLAY 
  { 
    block CSTACK1,
    rw section SELF_AREA1*,
    section .table.interrupt_core_1
  };
}
else
{
  define overlay SELF_AREA_OVERLAY 
  { 
    block CSTACK1,
    rw section SELF_AREA1*
  };
}

if (isdefinedsymbol(__ROPI) && size(SELF_AREA_region) != 0 )
{
  define overlay SELF_AREA_OVERLAY 
  { 
    block CSTACK2,
    rw section SELF_AREA2*,
    section .table.interrupt_core_2
  };
}
else
{
  define overlay SELF_AREA_OVERLAY 
  { 
    block CSTACK2,
    rw section SELF_AREA2*
  };
}

if (isdefinedsymbol(__ROPI) && size(SELF_AREA_region) != 0 )
{
  define overlay SELF_AREA_OVERLAY 
  { 
    block CSTACK3,
    rw section SELF_AREA3*,
    section .table.interrupt_core_3
  };
}
else
{
  define overlay SELF_AREA_OVERLAY 
  { 
    block CSTACK3,
    rw section SELF_AREA3*
  };
}

if (isdefinedsymbol(__ROPI) && size(SELF_AREA_region) != 0 )
{
  define overlay SELF_AREA_OVERLAY 
  { 
    block CSTACK4,
    rw section SELF_AREA4*,
    section .table.interrupt_core_4
  };
}
else
{
  define overlay SELF_AREA_OVERLAY 
  { 
    block CSTACK4,
    rw section SELF_AREA4*
  };
}

if (isdefinedsymbol(__ROPI) && size(SELF_AREA_region) != 0 )
{
  define overlay SELF_AREA_OVERLAY 
  { 
    block CSTACK5,
    rw section SELF_AREA5*,
    section .table.interrupt_core_5
  };
}
else
{
  define overlay SELF_AREA_OVERLAY 
  { 
    block CSTACK5,
    rw section SELF_AREA5*
  };
}

if (isdefinedsymbol(__ROPI) && size(SELF_AREA_region) != 0 )
{
  define overlay SELF_AREA_OVERLAY 
  { 
    block CSTACK6,
    rw section SELF_AREA6*,
    section .table.interrupt_core_6
  };
}
else
{
  define overlay SELF_AREA_OVERLAY 
  { 
    block CSTACK6,
    rw section SELF_AREA6*
  };
}

if (isdefinedsymbol(__ROPI) && size(SELF_AREA_region) != 0 )
{
  define overlay SELF_AREA_OVERLAY 
  { 
    block CSTACK7,
    rw section SELF_AREA7*,
    section .table.interrupt_core_7
  };
}
else
{
  define overlay SELF_AREA_OVERLAY 
  { 
    block CSTACK7,
    rw section SELF_AREA7*
  };
}

"SELFAREA":place in SELF_AREA_region
{ 
  overlay SELF_AREA_OVERLAY,
  rw section SELF_AREA*
};

"LOC0TH":place in LOC_0TH_region
{ 
  rw section LOCAL0_RAM*
};

"LOC1ST":place in LOC_1ST_region
{ 
  rw section LOCAL1_RAM*
};

"LOC2ND":place in LOC_2ND_region
{ 
  rw section LOCAL2_RAM*
};

"LOC3RD":place in LOC_3RD_region
{ 
  rw section LOCAL3_RAM*
};

"LOC4TH":place in LOC_4TH_region
{ 
  rw section LOCAL4_RAM*
};

"LOC5TH":place in LOC_5TH_region
{ 
  rw section LOCAL5_RAM*
};

"LOC6TH":place in LOC_6TH_region
{ 
  rw section LOCAL6_RAM*
};

"LOC7TH":place in LOC_7TH_region
{ 
  rw section LOCAL7_RAM*
};

"RAMRET":place in RAM_RET_region
{ 
  rw section RETENTION_RAM*
};
                        
use init table TableS for {  rw section SELF_AREA* }; 
use init table Table0 for {  rw section LOCAL0_RAM*, rw section SELF_AREA0* }; 
use init table Table1 for {  rw section LOCAL1_RAM*, rw section SELF_AREA1* }; 
use init table Table2 for {  rw section LOCAL2_RAM*, rw section SELF_AREA2* };		
use init table Table3 for {  rw section LOCAL3_RAM*, rw section SELF_AREA3* }; 
use init table Table4 for {  rw section LOCAL4_RAM*, rw section SELF_AREA4* };		
use init table Table5 for {  rw section LOCAL5_RAM*, rw section SELF_AREA5* }; 
use init table Table6 for {  rw section LOCAL6_RAM*, rw section SELF_AREA6* };		
use init table Table7 for {  rw section LOCAL7_RAM*, rw section SELF_AREA7* }; 

												
//-------------------------------------------------------------------------
//      End of File
//-------------------------------------------------------------------------
